# CY8C4248BZI_L489 register map
File version: 0.1
PSoC 4200L
Registers are 32-bit, read-write, no defined reset value unless marked. A register's access mark holds for its fields unless they carry their own. Offsets are from the block's base; lines under a group give offsets from that group; [hi:lo] are bit positions; {n}, {i} and the like mark numbered series; 'fields as' and 'values as' point back to an identical list; <NAME> marks a mode.

## Memory map
0x00000000 QuadDec1
0x00000000 QuadDec2
0x00000000 QuadDec0
0x00000000 DMAC — DMAC Registers
0x00000000 PWM0
0x00000000 PWM1
0x00000000 ADC — Sequencing SAR ADC
0x00000000 PWM2

## QuadDec1
Base 0x00000000
0x402001C8 COUNTER — Current counter value
0x402001CC CC — Compare / capture value
0x402001D0 CC_BUF — Compare / capture buffer value
0x402001D4 PERIOD — Period value
0x402001D8 PERIOD_BUF — Period buffer value

## QuadDec2
Base 0x00000000
0x40200208 COUNTER — Current counter value
0x4020020C CC — Compare / capture value
0x40200210 CC_BUF — Compare / capture buffer value
0x40200214 PERIOD — Period value
0x40200218 PERIOD_BUF — Period buffer value

## QuadDec0
Base 0x00000000
0x40200108 COUNTER — Current counter value
0x4020010C CC — Compare / capture value
0x40200110 CC_BUF — Compare / capture buffer value
0x40200114 PERIOD — Period value
0x40200118 PERIOD_BUF — Period buffer value

## PWM0
Base 0x00000000
0x40200248 COUNTER — Current counter value
0x4020024C CC — Compare / capture value
0x40200250 CC_BUF — Compare / capture buffer value
0x40200254 PERIOD — Period value
0x40200258 PERIOD_BUF — Period buffer value

## PWM1
Base 0x00000000
0x40200188 COUNTER — Current counter value
0x4020018C CC — Compare / capture value
0x40200190 CC_BUF — Compare / capture buffer value
0x40200194 PERIOD — Period value
0x40200198 PERIOD_BUF — Period buffer value

## PWM2
Base 0x00000000
0x40200148 COUNTER — Current counter value
0x4020014C CC — Compare / capture value
0x40200150 CC_BUF — Compare / capture buffer value
0x40200154 PERIOD — Period value
0x40200158 PERIOD_BUF — Period buffer value
